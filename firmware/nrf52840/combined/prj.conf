## CMakeLists.txt
```
cmake_minimum_required(VERSION 3.20.0)
find_package(Zephyr REQUIRED HINTS $ENV{ZEPHYR_BASE})
project(action_relay_combined)
target_sources(app PRIVATE src/miwear_l2.c)
target_sources(app PRIVATE src/camera_diag.c)
target_sources(app PRIVATE src/miwear_gatt.c)
target_sources(app PRIVATE src/miwear_companion.c src/miwear_runtime.c)
target_sources(app PRIVATE src/quiet_led.c)
list(APPEND CMAKE_MODULE_PATH ${ZEPHYR_BASE}/modules/nanopb)
include(nanopb)
zephyr_nanopb_sources(app miwear_auth.proto miwear_app.proto)
target_sources(app PRIVATE src/main.c src/hr_measurement.c src/activity.c src/radio_scan.c src/s4_link.c src/watch_diag.c src/miwear_pb.c src/miwear_session.c src/miwear_app.c ../protocol/miwear_auth.c ../protocol/miwear_l1.c ../protocol/miwear_sar.c ../protocol/miwear_psa.c)
```

## Kconfig
```
source "Kconfig.zephyr"
config WATCH_HR_RELAY
    bool
    default y
    select ANT
    select ANT_HRM
    select ANT_KEY_MANAGER
    select ANT_CHANNEL_CONFIG

config CADENCE_DEVICE_NUMBER
    int "ANT cadence device number (0 = learn first moving sensor until reboot)"
    default 0
    range 0 65535
```

## prj.conf
```kconfig
CONFIG_ANT=y
CONFIG_ANT_EVALUATION_KEY=y
CONFIG_BT=y
CONFIG_BT_CENTRAL=y
CONFIG_BT_GATT_CLIENT=y
CONFIG_BT_MAX_CONN=3
# Leave room for connection initiation alongside the 5-second ANT search window.
CONFIG_BT_CREATE_CONN_TIMEOUT=10
CONFIG_LOG=y
CONFIG_LOG_MODE_DEFERRED=y
CONFIG_HEAP_MEM_POOL_SIZE=4096
CONFIG_MAIN_STACK_SIZE=4096
CONFIG_NRF_SECURITY=y
CONFIG_NANOPB=y
CONFIG_MBEDTLS_PSA_CRYPTO_C=y
CONFIG_PSA_WANT_GENERATE_RANDOM=y
CONFIG_PSA_WANT_ALG_HMAC=y
CONFIG_PSA_WANT_ALG_SHA_256=y
CONFIG_PSA_WANT_KEY_TYPE_HMAC=y
CONFIG_PSA_WANT_KEY_TYPE_AES=y
CONFIG_PSA_WANT_ALG_CCM=y
CONFIG_PSA_WANT_ALG_CTR=y
CONFIG_PWM=y
```

## boards/promicro_nrf52840_nrf52840_uf2.conf
```kconfig
# Red Pro Micro clones may omit the 32.768 kHz crystal. Use the HF crystal
# synthesized LF clock for initial bring-up (higher power consumption).
CONFIG_CLOCK_CONTROL_NRF_K32SRC_SYNTH=y
CONFIG_CLOCK_CONTROL_NRF_K32SRC_50PPM=y
CONFIG_CDC_ACM_SERIAL_PRODUCT_STRING="Action Relay Combined"
CONFIG_REBOOT=y
```

## src/main.c
```c
/* BLE discovery flow adapted from Zephyr central_hr:
 * Copyright (c) 2015-2016 Intel Corporation
 * SPDX-License-Identifier: Apache-2.0
 */
#include <string.h>
#include <errno.h>
#include <zephyr/kernel.h>
#include <zephyr/logging/log.h>
#include <zephyr/bluetooth/bluetooth.h>
#include <zephyr/bluetooth/conn.h>
#include <zephyr/bluetooth/gatt.h>
#include <zephyr/bluetooth/hci.h>
#include <zephyr/sys/byteorder.h>
#include <zephyr/drivers/uart.h>
#include <zephyr/drivers/clock_control.h>
#include <zephyr/drivers/clock_control/nrf_clock_control.h>
#include <zephyr/sys/reboot.h>
#include <nrfx.h>
#include <ant_interface.h>
#include <ant_parameters.h>
#include <ant_key_manager.h>
#include <ant_channel_config.h>
#include <ant_profiles/hrm/ant_hrm.h>
#include "hr_measurement.h"
#include "activity.h"
#include "radio_scan.h"
#include "watch_diag.h"
#include "camera_diag.h"
#include "s4_link.h"
#include "quiet_led.h"
#include "../../protocol/miwear_psa.h"

LOG_MODULE_REGISTER(relay, LOG_LEVEL_INF);
#define STALE_MS 5000
static struct bt_conn *peer;
static atomic_t ble_allowed;
static struct activity activity;
static struct bt_uuid_16 uuid = BT_UUID_INIT_16(0);
static struct bt_gatt_discover_params discovery;
static struct bt_gatt_subscribe_params subscription;
static struct k_spinlock sample_lock;
static struct {
    uint8_t bpm, beats;
    uint16_t beat_time;
    uint32_t fraction;
    int64_t received, advanced;
    bool valid, rr;
} sample;
static ant_hrm_profile_t hrm;
K_MSGQ_DEFINE(ant_events, sizeof(ant_evt_t), 32, 4);
static atomic_t ant_overflow;
static atomic_t scan_reports;
static atomic_t ble_connected;
static bool ant_open, ant_closing;
static void usb_bootloader_check(void)
{
#if defined(CONFIG_BOARD_PROMICRO_NRF52840)
    const struct device *console = DEVICE_DT_GET(DT_CHOSEN(zephyr_console));
    static bool rx_enabled;
    if (!rx_enabled && device_is_ready(console)) {
        uart_irq_rx_enable(console);
        rx_enabled = true;
    }
    unsigned char command;
    static char line[96];
    static size_t length;
    static bool discard;
    /* B retains the old bootloader request; diagnostic lines require a newline.
     * Bound input handling so a host cannot monopolize the ANT main loop. */
    for (unsigned count = 0; count < 32 && uart_poll_in(console, &command) == 0; ++count) {
        if (command == 'B' && !length && !discard) {
            NRF_POWER->GPREGRET = 0x57;
            sys_reboot(SYS_REBOOT_COLD);
        } else if (command == '\r' || command == '\n') {
            if (length && !discard) {
                line[length] = 0;
                if (!quiet_led_command(line) && !camera_diag_command(line, k_uptime_get_32()) && !watch_diag_command(line)) LOG_WRN("Unknown USB command");
            }
            volatile char *clear = line;
            for (size_t i = 0; i < sizeof line; ++i) clear[i] = 0;
            length = 0; discard = false;
        } else if (!discard) {
            if (length < sizeof(line) - 1) line[length++] = command;
            else { discard = true; LOG_WRN("USB command too long; discarded"); }
        }
    }
#endif
}
static void profile_event(ant_hrm_profile_t *profile, ant_hrm_evt_t event);
HRM_SENS_PROFILE_CONFIG_DEF(relay, true, ANT_HRM_PAGE_0, profile_event);
/* Evaluation identity: device number 4242; manufacturer 255 = development. */
HRM_SENS_CHANNEL_CONFIG_DEF(relay, 0, 1, 4242, 0);

static void heart_disconnect(struct bt_conn *conn)
{
    if (conn != peer || !s4_link_prepare_disconnect(conn, S4_CLIENT_HEART)) return;
    int error = bt_conn_disconnect(conn, BT_HCI_ERR_REMOTE_USER_TERM_CONN);
    if (error) s4_link_cancel_disconnect(conn);
}
static void timeout_disconnect(struct bt_conn *conn, void *context)
{
    ARG_UNUSED(context);
    if (conn == peer) heart_disconnect(conn);
}
static void receive_timeout(struct k_work *work)
{
    ARG_UNUSED(work);
    LOG_WRN("No valid heart rate notification for 15 seconds; requesting link recovery");
    bt_conn_foreach(BT_CONN_TYPE_LE, timeout_disconnect, NULL);
}
K_WORK_DELAYABLE_DEFINE(receive_watchdog, receive_timeout);

static void subscribed(struct bt_conn *conn, uint8_t err,
                       struct bt_gatt_subscribe_params *params)
{
    ARG_UNUSED(params);
    if (err) {
        LOG_WRN("Heart rate notification subscription rejected: %u", err);
        heart_disconnect(conn);
    } else LOG_INF("Heart rate notifications enabled");
}

static void invalidate(void)
{
    k_spinlock_key_t key = k_spin_lock(&sample_lock);
    sample.valid = false;
    k_spin_unlock(&sample_lock, key);
}
static void profile_event(ant_hrm_profile_t *profile, ant_hrm_evt_t event)
{
    ARG_UNUSED(event);
    int64_t now = k_uptime_get();
    k_spinlock_key_t key = k_spin_lock(&sample_lock);
    bool fresh = sample.valid && now - sample.received < STALE_MS;
    if (fresh && !sample.rr) {
        /* No RR data: advance an estimated beat clock, never claim real HRV. */
        uint64_t units = sample.fraction + (uint64_t)(now - sample.advanced) * sample.bpm;
        uint32_t beats = units / 60000;
        sample.fraction = units % 60000;
        sample.beats += beats;
        sample.beat_time += beats * (61440U / sample.bpm);
        sample.advanced = now;
    }
    profile->HRM_PROFILE_computed_heart_rate = fresh ? sample.bpm : 0;
    profile->HRM_PROFILE_beat_count = sample.beats;
    profile->HRM_PROFILE_beat_time = sample.beat_time;
    profile->HRM_PROFILE_operating_time = now / 2000;
    k_spin_unlock(&sample_lock, key);
}
static uint8_t notified(struct bt_conn *conn, struct bt_gatt_subscribe_params *params,
                        const void *data, uint16_t length)
{
    if (!data) {
        params->value_handle = 0;
        invalidate();
        heart_disconnect(conn);
        return BT_GATT_ITER_STOP;
    }
    /* Keep the subscription alive for the companion owner during ANT standby. */
    if (!atomic_get(&ble_allowed)) return BT_GATT_ITER_CONTINUE;
    struct hr_measurement value;
    if (!hr_parse(data, length, &value)) {
        LOG_WRN("Malformed or unsupported heart rate measurement (%u bytes)", length);
        return BT_GATT_ITER_CONTINUE;
    }
    int64_t now = k_uptime_get();
    k_spinlock_key_t key = k_spin_lock(&sample_lock);
    bool reset = !sample.valid || now - sample.received >= STALE_MS;
    sample.bpm = value.bpm;
    sample.valid = value.bpm != 0 && !value.contact_lost;
    sample.received = now;
    sample.rr = value.rr_count != 0;
    if (reset) {
        sample.advanced = now;
        sample.fraction = 0;
        sample.beat_time = (uint16_t)(now * 1024 / 1000 - value.rr_ticks);
    }
    if (sample.valid && sample.rr) {
        sample.beats += value.rr_count;
        sample.beat_time += value.rr_ticks;
        sample.advanced = now;
        sample.fraction = 0;
    }
    k_spin_unlock(&sample_lock, key);
    k_work_reschedule(&receive_watchdog, K_SECONDS(15));
    LOG_INF("BLE HR %u bpm, RR intervals %u, contact %s", value.bpm,
            value.rr_count, value.contact_lost ? "lost" : "ok/unknown");
    return BT_GATT_ITER_CONTINUE;
}
static uint8_t discovered(struct bt_conn *conn, const struct bt_gatt_attr *attr,
                          struct bt_gatt_discover_params *params)
{
    int err;
    if (!attr) {
        LOG_WRN("Required heart rate attribute missing");
        heart_disconnect(conn);
        return BT_GATT_ITER_STOP;
    }
    if (params->type == BT_GATT_DISCOVER_PRIMARY) {
        const struct bt_gatt_service_val *service = attr->user_data;
        discovery.end_handle = service->end_handle;
        uuid.val = BT_UUID_HRS_MEASUREMENT_VAL;
        discovery.type = BT_GATT_DISCOVER_CHARACTERISTIC;
        discovery.start_handle = attr->handle + 1;
    } else if (params->type == BT_GATT_DISCOVER_CHARACTERISTIC) {
        const struct bt_gatt_chrc *chrc = attr->user_data;
        if (!(chrc->properties & BT_GATT_CHRC_NOTIFY)) {
            heart_disconnect(conn);
            return BT_GATT_ITER_STOP;
        }
        subscription.value_handle = chrc->value_handle;
        uuid.val = BT_UUID_GATT_CCC_VAL;
        discovery.type = BT_GATT_DISCOVER_DESCRIPTOR;
        discovery.start_handle = chrc->value_handle + 1;
    } else {
        subscription.notify = notified;
        subscription.subscribe = subscribed;
        subscription.value = BT_GATT_CCC_NOTIFY;
        subscription.ccc_handle = attr->handle;
        err = bt_gatt_subscribe(conn, &subscription);
        if (err && err != -EALREADY) {
            LOG_ERR("Subscribe failed: %d", err);
            heart_disconnect(conn);
        } else LOG_INF("Heart rate notifications requested");
        return BT_GATT_ITER_STOP;
    }
    err = bt_gatt_discover(conn, &discovery);
    if (err) {
        LOG_ERR("Discovery failed: %d", err);
        heart_disconnect(conn);
    }
    return BT_GATT_ITER_STOP;
}
static void scan_work_handler(struct k_work *work);
static void heart_ready(struct bt_conn *conn);
K_WORK_DELAYABLE_DEFINE(scan_work, scan_work_handler);
static void connection_create_failed(int err)
{
    LOG_WRN("Heart rate connection creation failed: %d", err);
    if (atomic_get(&ble_allowed)) k_work_reschedule(&scan_work, K_SECONDS(1));
}
static bool advertised(struct bt_data *data, void *context)
{
    bool *found = context;
    if (data->type == BT_DATA_UUID16_ALL || data->type == BT_DATA_UUID16_SOME) {
        for (size_t i = 0; i + 1 < data->data_len; i += 2) {
            if (sys_get_le16(data->data + i) == BT_UUID_HRS_VAL) *found = true;
        }
    }
    return true;
}
static void scan_result(const bt_addr_le_t *address, int8_t rssi, uint8_t type,
                        struct net_buf_simple *ad)
{
    ARG_UNUSED(rssi);
    atomic_inc(&scan_reports);
    if (!atomic_get(&ble_allowed) || peer || (type != BT_GAP_ADV_TYPE_ADV_IND && type != BT_GAP_ADV_TYPE_SCAN_RSP)) return;
    bool found = false;
    bt_data_parse(ad, advertised, &found);
    if (!found || !atomic_get(&ble_allowed)) return;
    radio_scan_request(RADIO_HEART, false);
    int err = radio_scan_connect(RADIO_HEART, address, &peer, connection_create_failed);
    if (err) {
        LOG_WRN("Connection creation failed: %d", err);
        k_work_reschedule(&scan_work, K_SECONDS(1));
    }
}
static void scan_work_handler(struct k_work *work)
{
    ARG_UNUSED(work);
    if (!atomic_get(&ble_allowed) || peer) return;
    peer = s4_link_acquire(S4_CLIENT_HEART, NULL);
    if (peer) {
        radio_scan_request(RADIO_HEART, false);
        heart_ready(peer);
        return;
    }
    radio_scan_request(RADIO_HEART, true);
    LOG_INF("Requested shared scan for BLE Heart Rate Service 180D");
}
static void connected(struct bt_conn *conn, uint8_t err)
{
    /* Other BLE links must not enter the heart-rate discovery state machine. */
    if (conn != peer) return;
    radio_scan_connected(RADIO_HEART);
    if (err) {
        if (peer) bt_conn_unref(peer);
        peer = NULL;
        k_work_reschedule(&scan_work, K_SECONDS(1));
        return;
    }
    heart_ready(conn);
}
static void heart_ready(struct bt_conn *conn)
{
    int ownership = s4_link_adopt(conn, S4_CLIENT_HEART);
    if (ownership && ownership != -EALREADY) LOG_WRN("Heart link registry unavailable: %d", ownership);
    if (!atomic_get(&ble_allowed) && !s4_link_has_other(conn, S4_CLIENT_HEART)) {
        heart_disconnect(conn);
        return;
    }
    LOG_INF("BLE connected; discovering heart rate service");
    atomic_set(&ble_connected, 1);
    k_work_reschedule(&receive_watchdog, K_SECONDS(15));
    memset(&subscription, 0, sizeof(subscription));
    memset(&discovery, 0, sizeof(discovery));
    uuid.val = BT_UUID_HRS_VAL;
    discovery.uuid = &uuid.uuid;
    discovery.func = discovered;
    discovery.type = BT_GATT_DISCOVER_PRIMARY;
    discovery.start_handle = BT_ATT_FIRST_ATTRIBUTE_HANDLE;
    discovery.end_handle = BT_ATT_LAST_ATTRIBUTE_HANDLE;
    if (bt_gatt_discover(conn, &discovery))
        heart_disconnect(conn);
}
static void disconnected(struct bt_conn *conn, uint8_t reason)
{
    if (conn != peer) return;
    LOG_INF("BLE disconnected: %u", reason);
    (void)s4_link_release(conn, S4_CLIENT_HEART);
    atomic_clear(&ble_connected);
    k_work_cancel_delayable(&receive_watchdog);
    invalidate();
    if (peer) bt_conn_unref(peer);
    peer = NULL;
    k_work_reschedule(&scan_work, K_SECONDS(1));
}
BT_CONN_CB_DEFINE(connection_callbacks) = {
    .connected = connected, .disconnected = disconnected,
};
static const char *activity_name(enum activity_state state)
{
    return state == ACTIVITY_STANDBY ? "standby" :
           state == ACTIVITY_SEARCHING ? "searching" : "forwarding";
}
static void ble_stop(void)
{
    atomic_clear(&ble_allowed);
    struct k_work_sync sync;
    k_work_cancel_delayable_sync(&scan_work, &sync);
    k_work_cancel_delayable(&receive_watchdog);
    radio_scan_request(RADIO_HEART, false);
    bt_conn_foreach(BT_CONN_TYPE_LE, timeout_disconnect, NULL);
    invalidate();
}
struct cadence_receiver {
    uint8_t channel, type;
    uint16_t period;
    bool open, closing;
    struct cadence_tracker tracker;
};
static struct cadence_receiver cadence_rx[] = {
    {.channel = 1, .type = 122, .period = 8102},
    {.channel = 2, .type = 121, .period = 8086},
};
static uint16_t cadence_id = CONFIG_CADENCE_DEVICE_NUMBER;
static uint8_t cadence_type;
static unsigned next_receiver;
static int64_t next_listen, listen_deadline;
static int cadence_setup(void)
{
    for (unsigned i = 0; i < ARRAY_SIZE(cadence_rx); ++i) {
        struct cadence_receiver *rx = &cadence_rx[i];
        const ant_channel_config_t cfg = {
            .channel_number = rx->channel, .channel_type = CHANNEL_TYPE_SLAVE,
            .device_type = rx->type, .device_number = cadence_id,
            .channel_period = rx->period, .rf_freq = 57, .network_number = 0,
        };
        int err = ant_channel_init(&cfg);
        /* High-priority search must not interrupt heart-rate transmission. */
        if (!err) err = ant_channel_rx_search_timeout_set(rx->channel, 0);
        if (!err) err = ant_channel_low_priority_rx_search_timeout_set(rx->channel, 2);
        if (err) return err;
    }
    return 0;
}
static bool cadence_event(ant_evt_t *event)
{
    for (unsigned i = 0; i < ARRAY_SIZE(cadence_rx); ++i) {
        struct cadence_receiver *rx = &cadence_rx[i];
        if (event->channel != rx->channel) continue;
        if (event->event == EVENT_CHANNEL_CLOSED) {
            rx->open = rx->closing = false;
            rx->tracker.initialized = false;
        } else if (event->event == EVENT_RX_FAIL_GO_TO_SEARCH) {
            rx->tracker.initialized = false;
        } else if (event->event == EVENT_RX && !rx->closing &&
                   event->message.ANT_MESSAGE_ucSize >= 9 &&
                   (event->message.ANT_MESSAGE_ucMesgID == MESG_BROADCAST_DATA_ID ||
                    event->message.ANT_MESSAGE_ucMesgID == MESG_ACKNOWLEDGED_DATA_ID)) {
            uint16_t id;
            uint8_t type, transmission;
            int err = ant_channel_id_get(rx->channel, &id, &type, &transmission);
            if (err || type != rx->type || (cadence_id && id != cadence_id) ||
                (cadence_type && type != cadence_type)) return false;
            bool moving = cadence_motion(&rx->tracker, type,
                event->message.ANT_MESSAGE_aucPayload, 8, k_uptime_get());
            if (moving && !cadence_type) {
                cadence_id = id;
                cadence_type = type;
                LOG_INF("Cadence sensor learned: id=%u type=%u (until reboot)", id, type);
            }
            return moving;
        }
        break;
    }
    return false;
}
static void cadence_poll(int64_t now, bool active)
{
    bool cooldown = !active && now < activity.retry_after;
    bool busy = false;
    for (unsigned i = 0; i < ARRAY_SIZE(cadence_rx); ++i) {
        struct cadence_receiver *rx = &cadence_rx[i];
        if (!active && (now >= listen_deadline || cooldown) && rx->open && !rx->closing) {
            int err = ant_channel_close(rx->channel);
            if (!err) rx->closing = true;
            else LOG_WRN("Cadence close failed: %d", err);
        }
        busy |= rx->open || rx->closing;
    }
    if (busy || cooldown || now < next_listen) return;
    struct cadence_receiver *rx = &cadence_rx[next_receiver];
    if (cadence_type) {
        rx = &cadence_rx[cadence_type == 122 ? 0 : 1];
    } else next_receiver = (next_receiver + 1) % ARRAY_SIZE(cadence_rx);
    int err = ant_channel_id_set(rx->channel, cadence_id, rx->type, 0);
    if (!err) err = ant_channel_open(rx->channel);
    next_listen = now + CADENCE_POLL_MS;
    if (err) LOG_WRN("Cadence search start failed: %d", err);
    else {
        rx->tracker.initialized = false;
        rx->open = true;
        listen_deadline = now + CADENCE_LISTEN_MS;
        LOG_INF("Cadence search: type=%u id=%u window=%u ms", rx->type, cadence_id, CADENCE_LISTEN_MS);
    }
}
static void ant_callback(ant_evt_t *event)
{
    if (k_msgq_put(&ant_events, event, K_NO_WAIT)) atomic_set(&ant_overflow, 1);
}
static void startup_error(const char *stage, int err)
{
    /* Keep the failure visible even if USB is opened after startup. */
    while (true) {
        usb_bootloader_check();
        LOG_ERR("%s initialization failed: %d", stage, err);
        k_sleep(K_SECONDS(5));
    }
}
int main(void)
{
    int err = ant_init();
    if (!err) err = ant_cb_register(ant_callback);
    if (!err) err = ant_plus_key_set(0);
    if (!err) err = ant_hrm_sens_init(&hrm, HRM_SENS_CHANNEL_CONFIG(relay),
                                     HRM_SENS_PROFILE_CONFIG(relay));
    if (err) startup_error("ANT", err);
#if defined(CONFIG_CLOCK_CONTROL_NRF_K32SRC_SYNTH)
    /* LFSYNTH must run from the crystal, not from the HF RC oscillator. */
    static struct onoff_client hf_client;
    sys_notify_init_spinwait(&hf_client.notify);
    int clock_err = onoff_request(z_nrf_clock_control_get_onoff(CLOCK_CONTROL_NRF_SUBSYS_HF),
                                  &hf_client);
    if (clock_err < 0) startup_error("HFXO request", clock_err);
    /* This MPSL/SYNTH configuration needs an explicit HFXO start. Keep the
       managed request held so the crystal remains available for LFSYNTH. */
    NRF_CLOCK->TASKS_HFCLKSTART = 1;
    int64_t deadline = k_uptime_get() + 1000;
    while ((NRF_CLOCK->HFCLKSTAT & 1) == 0) {
        if (k_uptime_get() >= deadline) startup_error("HFXO startup timeout", -ETIMEDOUT);
        k_sleep(K_MSEC(1));
    }
#endif
    hrm.HRM_PROFILE_manuf_id = 255;
    hrm.HRM_PROFILE_serial_num = 4242;
    hrm.HRM_PROFILE_hw_version = 1;
    hrm.HRM_PROFILE_sw_version = 1;
    hrm.HRM_PROFILE_model_num = 1;
    err = bt_enable(NULL);
    if (err) startup_error("BLE", err);
    int crypto_error = miwear_psa_init();
    LOG_INF("Companion crypto init: %d; one-use USB authentication available", crypto_error);
    radio_scan_init();
    quiet_led_init();
    radio_scan_register(RADIO_HEART, scan_result);
    watch_diag_init();
    camera_diag_init();
    err = cadence_setup();
    if (err) startup_error("Cadence RX", err);
    LOG_INF("Standby: waiting for crank motion; BLE search budget %u seconds", ACTIVITY_SEARCH_MS / 1000);
    int64_t next_status = 0;
    while (true) {
        usb_bootloader_check();
        bool motion = false;
        ant_evt_t event;
        if (!k_msgq_get(&ant_events, &event, K_MSEC(250))) {
            if (event.channel == 0) {
                if (event.event == EVENT_CHANNEL_CLOSED) {
                    ant_open = false;
                    ant_closing = false;
                }
                profile_event(&hrm, ANT_HRM_PAGE_0_UPDATED);
                ant_hrm_sens_evt_handler(&event, &hrm);
            } else motion = cadence_event(&event);
        }
        if (atomic_get(&ant_overflow)) { LOG_ERR("ANT event overflow"); k_oops(); }
        int64_t now = k_uptime_get();
        camera_diag_poll((uint32_t)now);
        /* A companion may have released a retained idle HRS connection. */
        static int64_t next_idle_check;
        if (now >= next_idle_check) {
            next_idle_check = now + 1000;
            if (!atomic_get(&ble_allowed)) bt_conn_foreach(BT_CONN_TYPE_LE, timeout_disconnect, NULL);
        }
        k_spinlock_key_t key = k_spin_lock(&sample_lock);
        bool fresh = sample.valid && now - sample.received < STALE_MS;
        int64_t hr_received = sample.received;
        k_spin_unlock(&sample_lock, key);
        enum activity_state before = activity.state;
        activity_step(&activity, now, motion, fresh, hr_received);
        if (activity.state != before) {
            LOG_INF("Activity: %s -> %s", activity_name(before), activity_name(activity.state));
            if (activity.state == ACTIVITY_SEARCHING) {
                invalidate();
                atomic_set(&ble_allowed, 1);
                k_work_reschedule(&scan_work, K_NO_WAIT);
            } else if (activity.state == ACTIVITY_STANDBY) {
                ble_stop();
            }
        }
        fresh = fresh && activity.state == ACTIVITY_FORWARDING;
        cadence_poll(now, activity.state != ACTIVITY_STANDBY);
        if (now >= next_status) {
            LOG_INF("Status: mode=%s BLE=%s scan_reports=%ld fresh_HR=%u ANT=%u cadence_id=%u",
                    activity_name(activity.state),
                    atomic_get(&ble_connected) ? "connected" :
                    atomic_get(&ble_allowed) ? "scanning" : "off",
                    (long)atomic_get(&scan_reports), fresh, ant_open, cadence_id);
            next_status = now + (activity.state == ACTIVITY_STANDBY ? 30000 : 5000);
        }
        if (fresh && !ant_open && !ant_closing) {
            profile_event(&hrm, ANT_HRM_PAGE_0_UPDATED);
            err = ant_hrm_sens_open(&hrm);
            if (!err) { ant_open = true; LOG_INF("ANT+ HR started, device 4242"); }
            else { LOG_ERR("ANT open failed: %d", err); k_sleep(K_SECONDS(1)); }
        } else if (!fresh && ant_open && !ant_closing) {
            err = ant_channel_close(0);
            if (!err) { ant_closing = true; LOG_INF("ANT+ paused: no fresh heart rate"); }
            else { LOG_ERR("ANT close failed: %d", err); k_sleep(K_SECONDS(1)); }
        }
    }
}
```

## src/activity.c
```c
#include "activity.h"
static uint16_t le16(const uint8_t *p) { return p[0] | ((uint16_t)p[1] << 8); }
static void standby(struct activity *s, int64_t now)
{
    s->state = ACTIVITY_STANDBY;
    s->retry_after = now + ACTIVITY_RETRY_MS;
}
void activity_step(struct activity *s, int64_t now, bool motion,
                   bool fresh_hr, int64_t hr_received)
{
    if (motion) s->last_motion = now;
    if (s->state == ACTIVITY_STANDBY) {
        if (motion && now >= s->retry_after) {
            s->state = ACTIVITY_SEARCHING;
            s->deadline = now + ACTIVITY_SEARCH_MS;
        }
        return;
    }
    if (now - s->last_motion >= ACTIVITY_INACTIVE_MS) {
        standby(s, now);
    } else if (s->state == ACTIVITY_SEARCHING) {
        if (fresh_hr && now < s->deadline) {
            s->state = ACTIVITY_FORWARDING;
            s->deadline = hr_received + ACTIVITY_HR_LOST_MS;
        } else if (now >= s->deadline) standby(s, now);
    } else {
        if (fresh_hr) s->deadline = hr_received + ACTIVITY_HR_LOST_MS;
        if (now >= s->deadline) standby(s, now);
    }
}
bool cadence_motion(struct cadence_tracker *s, uint8_t type,
                    const uint8_t *p, size_t size, int64_t now)
{
    if (!p || size < 8 || (type != 121 && type != 122)) return false;
    if (type == 122 && (p[0] & 0x7f) > 5) return false;
    unsigned offset = type == 121 ? 0 : 4;
    uint16_t event = le16(p + offset), rev = le16(p + offset + 2);
    bool moving = false;
    if (s->initialized && now - s->received < 30000) {
        uint16_t dr = (uint16_t)(rev - s->revolutions);
        uint16_t dt = (uint16_t)(event - s->event_time);
        /* Count/event rollover is valid. Reject resets, duplicates and >250 rpm. */
        moving = dr > 0 && dt > 0 && (uint32_t)dr * 61440 <= (uint32_t)dt * 250;
    }
    s->initialized = true;
    s->revolutions = rev;
    s->event_time = event;
    s->received = now;
    return moving;
}
```

## src/activity.h
```c
#ifndef ACTIVITY_H
#define ACTIVITY_H
#include <stdbool.h>
#include <stdint.h>
#include <stddef.h>
#define ACTIVITY_SEARCH_MS 45000
#define ACTIVITY_RETRY_MS 60000
#define ACTIVITY_INACTIVE_MS 180000
#define ACTIVITY_HR_LOST_MS 30000
#define CADENCE_LISTEN_MS 5000
#define CADENCE_POLL_MS 20000

enum activity_state { ACTIVITY_STANDBY, ACTIVITY_SEARCHING, ACTIVITY_FORWARDING };
struct activity {
    enum activity_state state;
    int64_t deadline, retry_after, last_motion;
};
/* Main-thread only; motion is a validated crank revolution, not an RF packet. */
void activity_step(struct activity *state, int64_t now, bool motion,
                   bool fresh_hr, int64_t hr_received);
struct cadence_tracker {
    bool initialized;
    uint16_t revolutions, event_time;
    int64_t received;
};
/* type 122: cadence only; type 121: speed/cadence combined. */
bool cadence_motion(struct cadence_tracker *state, uint8_t type,
                    const uint8_t *payload, size_t size, int64_t now);
#endif
```

## src/camera_diag.c
```c
/* Read-only camera discovery. Reuses the manufacturer-data predicate used by
 * the working Android relay. Candidate != verified Action 4 or authorization. */
#include <string.h>
#include <zephyr/kernel.h>
#include <zephyr/logging/log.h>
#include "camera_diag.h"
#include "radio_scan.h"
LOG_MODULE_REGISTER(camera_diag, LOG_LEVEL_INF);
static struct k_spinlock lock;
static bool scanning;
static uint32_t deadline;
static bt_addr_le_t seen[8];
static size_t seen_count;
struct advert { bool dji; char name[32]; };
static bool field(struct bt_data *data, void *context)
{
    struct advert *advert = context;
    if (data->type == BT_DATA_MANUFACTURER_DATA && data->data_len >= 5 &&
        data->data[0] == 0xaa && data->data[1] == 0x08 && data->data[4] == 0xfa) advert->dji = true;
    if (data->type == BT_DATA_NAME_COMPLETE || data->type == BT_DATA_NAME_SHORTENED) {
        size_t n = MIN(data->data_len, sizeof advert->name - 1);
        for (size_t i = 0; i < n; ++i) advert->name[i] = data->data[i] < 32 || data->data[i] == 127 ? '?' : data->data[i];
        advert->name[n] = 0;
    }
    return true;
}
static void advertisement(const bt_addr_le_t *address, int8_t rssi, uint8_t type,
                           struct net_buf_simple *data)
{
    ARG_UNUSED(type);
    struct advert advert = {0};
    bt_data_parse(data, field, &advert);
    if (!advert.dji) return;
    k_spinlock_key_t key = k_spin_lock(&lock);
    if (!scanning || seen_count == ARRAY_SIZE(seen)) { k_spin_unlock(&lock, key); return; }
    for (size_t i = 0; i < seen_count; ++i)
        if (!bt_addr_le_cmp(&seen[i], address)) { k_spin_unlock(&lock, key); return; }
    seen[seen_count++] = *address;
    k_spin_unlock(&lock, key);
    char text[BT_ADDR_LE_STR_LEN];
    bt_addr_le_to_str(address, text, sizeof text);
    LOG_INF("DJI candidate %s RSSI=%d name=%s (not authorized)", text, rssi, advert.name);
}
void camera_diag_init(void) { radio_scan_register(RADIO_CAMERA, advertisement); }
bool camera_diag_command(const char *line, uint32_t now)
{
    if (!line || (strcmp(line, "camera scan") && strcmp(line, "camera stop"))) return false;
    bool start = !strcmp(line, "camera scan");
    k_spinlock_key_t key = k_spin_lock(&lock);
    scanning = start;
    if (start) { seen_count = 0; deadline = now + 10000U; }
    k_spin_unlock(&lock, key);
    radio_scan_request(RADIO_CAMERA, start);
    LOG_INF("Camera discovery %s; no connections or pairing", start ? "started (10s)" : "stopped");
    return true;
}
void camera_diag_poll(uint32_t now)
{
    k_spinlock_key_t key = k_spin_lock(&lock);
    bool expired = scanning && (int32_t)(now - deadline) >= 0;
    size_t count = seen_count;
    if (expired) scanning = false;
    k_spin_unlock(&lock, key);
    if (expired) {
        radio_scan_request(RADIO_CAMERA, false);
        LOG_INF("Camera discovery finished: %u unique candidates", (unsigned)count);
    }
}
```

## src/camera_diag.h
```c
#ifndef ACTION_RELAY_CAMERA_DIAG_H
#define ACTION_RELAY_CAMERA_DIAG_H
#include <stdbool.h>
#include <stdint.h>
void camera_diag_init(void);
bool camera_diag_command(const char *, uint32_t now_ms);
void camera_diag_poll(uint32_t now_ms);
#endif
```

## src/hr_measurement.c
```c
#include "hr_measurement.h"
static uint16_t le16(const uint8_t *p) { return p[0] | ((uint16_t)p[1] << 8); }
bool hr_parse(const uint8_t *data, size_t len, struct hr_measurement *out)
{
    if (!data || !out || len < 2) return false;
    struct hr_measurement value = {0};
    uint8_t flags = data[0];
    size_t pos = (flags & 1) ? 3 : 2;
    if (len < pos) return false;
    uint16_t bpm = (flags & 1) ? le16(data + 1) : data[1];
    if (bpm > 255) return false;
    value.bpm = bpm;
    value.contact_lost = (flags & 4) && !(flags & 2);
    if (flags & 8) {
        if (len - pos < 2) return false;
        pos += 2;
    }
    if (flags & 16) {
        if (len == pos || (len - pos) % 2) return false;
        while (pos < len) {
            uint16_t rr = le16(data + pos);
            if (!rr) return false;
            value.rr_count++;
            value.rr_ticks += rr;
            pos += 2;
        }
    } else if (pos != len) {
        return false;
    }
    *out = value;
    return true;
}
```

## src/hr_measurement.h
```c
#ifndef HR_MEASUREMENT_H
#define HR_MEASUREMENT_H
#include <stdint.h>
#include <stddef.h>
#include <stdbool.h>
struct hr_measurement {
    uint8_t bpm;
    bool contact_lost;
    uint16_t rr_count;
    uint32_t rr_ticks;
};
/* RR and ANT beat timestamps both use units of 1/1024 second. */
bool hr_parse(const uint8_t *data, size_t len, struct hr_measurement *out);
#endif
```

## src/miwear_app.c
```c
#include <string.h>
#include <pb_decode.h>
#include <pb_encode.h>
#include "miwear_app.pb.h"
#include "miwear_app.h"

static bool identity(actionrelayapp_Identity *out, const char *package,
                     const uint8_t *fingerprint, size_t length)
{
    if (!package || !fingerprint || !length || length > sizeof out->fingerprint.bytes) return false;
    size_t n = 0;
    while (n <= sizeof out->package_name.bytes && package[n]) ++n;
    if (!n || n > sizeof out->package_name.bytes) return false;
    out->package_name.size = n;
    memcpy(out->package_name.bytes, package, n);
    out->fingerprint.size = length;
    memcpy(out->fingerprint.bytes, fingerprint, length);
    return true;
}
static bool matches(const actionrelayapp_Identity *a, const actionrelayapp_Identity *b)
{
    return a->package_name.size == b->package_name.size &&
        !memcmp(a->package_name.bytes, b->package_name.bytes, a->package_name.size) &&
        a->fingerprint.size == b->fingerprint.size &&
        !memcmp(a->fingerprint.bytes, b->fingerprint.bytes, a->fingerprint.size);
}
bool miwear_app_receive(const uint8_t *input, size_t length, const char *package,
    const uint8_t *fingerprint, size_t fingerprint_length, struct miwear_app_message *out)
{
    if (!out) return false;
    memset(out, 0, sizeof *out);
    if (!input || !length || length > 1024) return false;
    actionrelayapp_Identity expected = actionrelayapp_Identity_init_zero;
    if (!identity(&expected, package, fingerprint, fingerprint_length)) return false;
    actionrelayapp_Envelope packet = actionrelayapp_Envelope_init_zero;
    pb_istream_t stream = pb_istream_from_buffer(input, length);
    if (!pb_decode(&stream, actionrelayapp_Envelope_fields, &packet) || packet.type != 20 || !packet.has_app) return false;
    if (packet.id == 6 && packet.app.which_payload == actionrelayapp_App_identity_tag &&
        matches(&packet.app.payload.identity, &expected)) {
        out->kind = MIWEAR_APP_STATUS_REQUEST;
        return true;
    }
    if (packet.id != 9 || packet.app.which_payload != actionrelayapp_App_content_tag ||
        !matches(&packet.app.payload.content.identity, &expected)) return false;
    out->length = packet.app.payload.content.content.size;
    memcpy(out->content, packet.app.payload.content.content.bytes, out->length);
    out->kind = MIWEAR_APP_MESSAGE;
    return true;
}
static size_t encode(uint8_t *output, size_t capacity, const actionrelayapp_Envelope *packet)
{
    if (!output) return 0;
    pb_ostream_t stream = pb_ostream_from_buffer(output, capacity);
    return pb_encode(&stream, actionrelayapp_Envelope_fields, packet) ? stream.bytes_written : 0;
}
size_t miwear_app_send(uint8_t *output, size_t capacity, const char *package,
    const uint8_t *fingerprint, size_t fingerprint_length, const uint8_t *content, size_t length)
{
    if ((!content && length) || length > MIWEAR_APP_CONTENT_MAX) return 0;
    actionrelayapp_Envelope packet = actionrelayapp_Envelope_init_zero;
    packet.type = 20; packet.id = 8; packet.has_app = true;
    packet.app.which_payload = actionrelayapp_App_content_tag;
    if (!identity(&packet.app.payload.content.identity, package, fingerprint, fingerprint_length)) return 0;
    packet.app.payload.content.content.size = length;
    if (length) memcpy(packet.app.payload.content.content.bytes, content, length);
    return encode(output, capacity, &packet);
}
size_t miwear_app_status(uint8_t *output, size_t capacity, const char *package,
    const uint8_t *fingerprint, size_t fingerprint_length, bool connected)
{
    actionrelayapp_Envelope packet = actionrelayapp_Envelope_init_zero;
    packet.type = 20; packet.id = 7; packet.has_app = true;
    packet.app.which_payload = actionrelayapp_App_status_tag;
    if (!identity(&packet.app.payload.status.identity, package, fingerprint, fingerprint_length)) return 0;
    packet.app.payload.status.status = connected ? 1 : 2;
    return encode(output, capacity, &packet);
}
```

## src/miwear_app.h
```c
#ifndef ACTION_RELAY_MIWEAR_APP_H
#define ACTION_RELAY_MIWEAR_APP_H
#include <stdbool.h>
#include <stddef.h>
#include <stdint.h>
#define MIWEAR_APP_CONTENT_MAX 768
enum miwear_app_kind { MIWEAR_APP_INVALID, MIWEAR_APP_STATUS_REQUEST, MIWEAR_APP_MESSAGE };
struct miwear_app_message {
    enum miwear_app_kind kind;
    size_t length;
    uint8_t content[MIWEAR_APP_CONTENT_MAX];
};
/* Decode only messages addressed to the configured package AND certificate fingerprint.
 * Call only after authenticated L2 decryption. No transport or JSON execution here. */
bool miwear_app_receive(const uint8_t *, size_t, const char *package,
    const uint8_t *fingerprint, size_t fingerprint_length, struct miwear_app_message *);
/* Return zero on failure. Caller copies the result before reuse; never log payloads. */
size_t miwear_app_send(uint8_t *, size_t, const char *, const uint8_t *, size_t,
    const uint8_t *, size_t);
size_t miwear_app_status(uint8_t *, size_t, const char *, const uint8_t *, size_t, bool connected);
#endif
```

## src/miwear_companion.c
```c
/* Serial integration of tested framing/SAR/L2/auth. No pairing or key storage. */
#include <string.h>
#include "miwear_companion.h"
#include "miwear_l2.h"
enum { OPENED = 1, RESET = 2, FAILED = 4, VERIFIED = 8 };
static void wipe(void *data, size_t length) { volatile uint8_t *p = data; while (length--) *p++ = 0; }
static int send_wire(void *context, const uint8_t *bytes, size_t length)
{ struct miwear_companion *s = context; return s->ops.send ? s->ops.send(s->ops.context, bytes, length) : -1; }
static void sar_event(void *context, enum miwear_sar_event event)
{
    struct miwear_companion *s = context;
    if (event == MIWEAR_SAR_OPENED) s->events |= OPENED;
    if (event == MIWEAR_SAR_RESET) s->events |= RESET;
    if (event == MIWEAR_SAR_ERROR) s->events |= FAILED;
}
static void auth_event(void *context, enum miwear_auth_event event)
{
    struct miwear_companion *s = context;
    if (event == MIWEAR_AUTH_ACCEPTED) s->events |= VERIFIED;
    if (event == MIWEAR_AUTH_REJECTED) s->events |= FAILED;
}
static void sar_data(void *context, const uint8_t *bytes, size_t length)
{
    struct miwear_companion *s = context;
    if (s->rx_count == 2 || length > sizeof s->rx[0]) { s->overflow = true; return; }
    unsigned slot = (s->rx_head + s->rx_count) % 2;
    memcpy(s->rx[slot], bytes, length); s->rx_length[slot] = length; ++s->rx_count;
}
static void frame(void *context, const struct miwear_l1_view *packet)
{ struct miwear_companion *s = context; miwear_sar_receive(&s->sar, packet, s->now); }
static int send_auth(void *context, const uint8_t *bytes, size_t length)
{
    struct miwear_companion *s = context;
    size_t size = miwear_l2_auth_write(s->outgoing, sizeof s->outgoing, bytes, length);
    return size ? miwear_sar_send(&s->sar, s->outgoing, size, s->now) : -1;
}
static void state(struct miwear_companion *s, enum miwear_companion_state value)
{ s->state = value; if (s->ops.state) s->ops.state(s->ops.context, value); }
void miwear_companion_init(struct miwear_companion *s, const struct miwear_companion_ops *ops)
{
    memset(s, 0, sizeof *s); if (ops) s->ops = *ops;
    miwear_sar_init(&s->sar, send_wire, sar_event, sar_data, s);
    miwear_auth_session_init(&s->auth, send_auth, auth_event, s);
}
void miwear_companion_close(struct miwear_companion *s)
{
    if (!s) return;
    struct miwear_companion_ops ops = s->ops;
    wipe(s, sizeof *s); miwear_companion_init(s, &ops);
}
static void failed(struct miwear_companion *s)
{
    miwear_companion_close(s); state(s, MIWEAR_COMPANION_FAILED);
}
int miwear_companion_start(struct miwear_companion *s, const uint8_t key[16], const uint8_t nonce[16], uint32_t now)
{
    if (!s || !key || !nonce || !s->ops.send || (s->state != MIWEAR_COMPANION_IDLE && s->state != MIWEAR_COMPANION_FAILED)) return -1;
    miwear_companion_close(s); s->now = now; memcpy(s->key, key, 16); memcpy(s->nonce, nonce, 16);
    state(s, MIWEAR_COMPANION_SAR);
    if (miwear_sar_start(&s->sar, now)) { failed(s); return -1; }
    return 0;
}
void miwear_companion_poll(struct miwear_companion *s, uint32_t now)
{
    if (!s || s->state == MIWEAR_COMPANION_IDLE || s->state == MIWEAR_COMPANION_FAILED) return;
    s->now = now;
    miwear_sar_tick(&s->sar, now);
    for (unsigned count = 0; count < 4; ++count) {
        unsigned events = s->events; s->events = 0;
        if (s->overflow || (events & (RESET | FAILED))) { failed(s); return; }
        if ((events & OPENED) && s->state == MIWEAR_COMPANION_SAR) {
            state(s, MIWEAR_COMPANION_AUTH);
            int error = miwear_auth_session_begin(&s->auth, s->key, s->nonce, 1, now);
            wipe(s->key, sizeof s->key); wipe(s->nonce, sizeof s->nonce);
            if (error) { failed(s); return; }
        }
        if ((events & VERIFIED) && s->auth.state == MIWEAR_AUTH_READY) state(s, MIWEAR_COMPANION_READY);
        if (!s->rx_count) break;
        unsigned slot = s->rx_head; size_t length = 0;
        enum miwear_l2_kind kind = miwear_l2_receive(&s->auth, s->rx[slot], s->rx_length[slot], s->incoming, sizeof s->incoming, &length);
        wipe(s->rx[slot], sizeof s->rx[slot]); s->rx_length[slot] = 0;
        s->rx_head = (s->rx_head + 1) % 2; --s->rx_count;
        if (kind == MIWEAR_L2_AUTH) miwear_auth_session_receive(&s->auth, s->incoming, length, now);
        else if (kind == MIWEAR_L2_APP && s->state == MIWEAR_COMPANION_READY && s->ops.application)
            s->ops.application(s->ops.context, s->incoming, length);
        wipe(s->incoming, sizeof s->incoming);
    }
    miwear_auth_session_poll(&s->auth, now);
    if (s->events & FAILED) failed(s);
    else if ((s->events & VERIFIED) && s->auth.state == MIWEAR_AUTH_READY) {
        s->events &= ~VERIFIED; state(s, MIWEAR_COMPANION_READY);
    }
}
void miwear_companion_receive(struct miwear_companion *s, const uint8_t *bytes, size_t length, uint32_t now)
{
    if (!s || (!bytes && length) || s->state == MIWEAR_COMPANION_IDLE || s->state == MIWEAR_COMPANION_FAILED) return;
    s->now = now; miwear_l1_feed(&s->stream, bytes, length, frame, s); miwear_companion_poll(s, now);
}
int miwear_companion_send_pb(struct miwear_companion *s, const uint8_t *bytes, size_t length, uint32_t now)
{
    if (!s || s->state != MIWEAR_COMPANION_READY) return -1;
    size_t size = miwear_l2_app_write(&s->auth, s->outgoing, sizeof s->outgoing, bytes, length);
    return size ? miwear_sar_send(&s->sar, s->outgoing, size, now) : -1;
}
```

## src/miwear_companion.h
```c
#ifndef ACTION_RELAY_MIWEAR_COMPANION_H
#define ACTION_RELAY_MIWEAR_COMPANION_H
#include "miwear_session.h"
#include "../../protocol/miwear_sar.h"
enum miwear_companion_state { MIWEAR_COMPANION_IDLE, MIWEAR_COMPANION_SAR,
    MIWEAR_COMPANION_AUTH, MIWEAR_COMPANION_READY, MIWEAR_COMPANION_FAILED };
struct miwear_companion_ops {
    int (*send)(void *, const uint8_t *, size_t);
    void (*state)(void *, enum miwear_companion_state);
    /* Decrypted application PB; caller must still validate package/fingerprint/JSON. */
    void (*application)(void *, const uint8_t *, size_t);
    void *context;
};
struct miwear_companion {
    struct miwear_companion_ops ops;
    struct miwear_sar sar;
    struct miwear_auth_session auth;
    struct miwear_l1_stream stream;
    enum miwear_companion_state state;
    uint8_t key[16], nonce[16];
    uint8_t incoming[1024], outgoing[1024], rx[2][1024];
    size_t rx_length[2];
    unsigned rx_head, rx_count, events;
    uint32_t now;
    bool overflow;
};
/* Serialize all calls on one thread; callbacks must copy and must not reenter. */
void miwear_companion_init(struct miwear_companion *, const struct miwear_companion_ops *);
int miwear_companion_start(struct miwear_companion *, const uint8_t key[16], const uint8_t fresh_nonce[16], uint32_t);
void miwear_companion_receive(struct miwear_companion *, const uint8_t *, size_t, uint32_t);
void miwear_companion_poll(struct miwear_companion *, uint32_t);
int miwear_companion_send_pb(struct miwear_companion *, const uint8_t *, size_t, uint32_t);
void miwear_companion_close(struct miwear_companion *);
#endif
```

## src/miwear_gatt.h
```c
#ifndef ACTION_RELAY_MIWEAR_GATT_H
#define ACTION_RELAY_MIWEAR_GATT_H
#include <stddef.h>
#include <stdint.h>
#include <stdbool.h>
#include <zephyr/bluetooth/conn.h>
struct miwear_gatt_callbacks {
    /* RX callback runs on the Bluetooth thread: copy/enqueue, never do crypto. */
    void (*received)(const uint8_t *, size_t);
    /* Ready/closed run on the private transport queue. */
    void (*ready)(uint32_t generation);
    void (*closed)(int);
};
void miwear_gatt_init(const struct miwear_gatt_callbacks *);
int miwear_gatt_open(struct bt_conn *);
void miwear_gatt_close(void);
bool miwear_gatt_busy(void);
/* Copies one whole L1 frame. 0 queued, -EAGAIN full; never camera confirmation. */
int miwear_gatt_send(const uint8_t *, size_t);
int miwear_gatt_send_for(uint32_t generation, const uint8_t *, size_t);
#endif
```
